## InkWord_Firmware/sdkconfig.defaults
```kconfig
# sdkconfig.defaults - Arduino-ESP32 底层配置
# Flash 配置 (16MB)
CONFIG_ESPTOOLPY_FLASHSIZE_16MB=y
CONFIG_ESPTOOLPY_FLASHSIZE="16MB"

# PSRAM 配置（暂时禁用）
# CONFIG_ESP32S3_SPIRAM is not set
# CONFIG_SPIRAM is not set

# 分区表
CONFIG_PARTITION_TABLE_CUSTOM=y
CONFIG_PARTITION_TABLE_CUSTOM_FILENAME="partitions_default.csv"

# FreeRTOS
CONFIG_FREERTOS_HZ=1000
```
